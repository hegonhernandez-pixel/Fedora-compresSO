## compressos-hal-exp/buildroot-external/Config.in
```kconfig
menu "CompressOS-HAL experimental components"
source "$BR2_EXTERNAL_COMPRESSO_PATH/package/compresso-memoryd/Config.in"
endmenu
```

## compressos-hal-exp/buildroot-external/package/compresso-memoryd/Config.in
```kconfig
config BR2_PACKAGE_COMPRESSO_MEMORYD
 bool "compresso-memoryd"
 depends on BR2_PACKAGE_PYTHON3
 help
   Experimental ZRAM/Zswap configurator; disabled by default.
```
